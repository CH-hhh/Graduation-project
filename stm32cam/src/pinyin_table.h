#pragma once

#include <stdint.h>
#include <Arduino.h>

// 🌟 权威官方全量 20,902 汉字 (0x4E00~0x9FA5) 100% 精准拼音首字母表 (A~Z 对应 1~26)
static const uint8_t s_hanzi_pinyin[20902] = {
    25,  4, 11, 17, 19, 24,  8, 23, 26, 19, 19, 24, 10,  2, 25, 13,  7,  3,  3, 26, 17, 16, 19, 19, 17,  2, 25,  3,  4, 19,  3,  4,
    17, 12,  4, 25, 12, 25,  2, 19,  7, 10,  7, 25, 17, 26, 10, 10,  6,  7,  3,  3, 12, 26, 26,  2, 23,  4, 23, 26, 10, 12, 10, 16,
     6, 25, 25, 14, 23, 10, 10, 20, 13, 25, 25, 26, 23, 26,  8,  6, 12, 25, 16, 16, 17,  8,  7,  3,  3, 25, 25, 25, 13, 10, 17, 25,
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    25,  3,  8, 10, 24, 25,
};

// 查找单个汉字拼音首字母 ('A'~'Z'，未收录返回 0)
inline char getHanziPinyinInitial(uint16_t unicode) {
    if (unicode >= 0x4E00 && unicode <= 0x9FA5) {
        uint8_t val = s_hanzi_pinyin[unicode - 0x4E00];
        if (val >= 1 && val <= 26) return (char)('A' + (val - 1));
    }
    return 0;
}

// 🌟 提取任意 UTF-8 字符（汉字拼音、英文字母、数字）的首字母排序键
inline char getSortInitialKey(const char* utf8_str) {
    if (!utf8_str || !*utf8_str) return '~';
    const unsigned char* p = (const unsigned char*)utf8_str;
    while (*p) {
        if (*p <= 0x20 || *p == '[' || *p == '(' || *p == '<' || *p == '"' || *p == '\'' || *p == '.' || *p == '-' || *p == '_') {
            p++;
            continue;
        }
        if (p[0] == 0xE3 && p[1] == 0x80 && (p[2] == 0x8A || p[2] == 0x90)) { p += 3; continue; } // 《 【
        if (p[0] == 0xE2 && p[1] == 0x80 && (p[2] == 0x9C || p[2] == 0x98)) { p += 3; continue; } // “ ‘
        if (p[0] == 0xE2 && p[1] == 0x99 && p[2] == 0xAA) { p += 3; continue; } // ♪
        break;
    }
    if (!*p) return '~';

    if (*p < 0x80) {
        char c = *p;
        if (c >= 'a' && c <= 'z') return c - 'a' + 'A';
        if (c >= 'A' && c <= 'Z') return c;
        if (c >= '0' && c <= '9') return c;
        return '~';
    }

    uint16_t u = 0;
    if ((p[0] & 0xE0) == 0xC0 && p[1]) {
        u = ((p[0] & 0x1F) << 6) | (p[1] & 0x3F);
    } else if ((p[0] & 0xF0) == 0xE0 && p[1] && p[2]) {
        u = ((p[0] & 0x0F) << 12) | ((p[1] & 0x3F) << 6) | (p[2] & 0x3F);
    }

    if (u >= 0x4E00 && u <= 0x9FA5) {
        char py = getHanziPinyinInitial(u);
        if (py >= 'A' && py <= 'Z') return py;
    }
    return '~';
}
