#pragma once

#include <stdint.h>
#include <Arduino.h>

#if defined(ESP32)
  #include <pgmspace.h>
#elif defined(STM32_CORE) || defined(ARDUINO_ARCH_STM32)
  #ifndef PROGMEM
    #define PROGMEM
  #endif
  #ifndef pgm_read_byte
    #define pgm_read_byte(addr) (*(const uint8_t*)(addr))
  #endif
#endif

// 🌟 全量 20,902 汉字 (0x4E00~0x9FA5) 4-bit 紧凑拼音首字母表 (仅占用 10.2 KB Flash)
static const uint8_t s_hanzi_pinyin_nibbles[10451] PROGMEM = {
    0x94, 0xB1, 0x38, 0x87, 0xA3, 0x38, 0xA2, 0x9D, 0x73, 0x3A, 0x10, 0x33, 0x12, 0x93, 0x43, 0x34,
    0x1C, 0x49, 0xC9, 0x23, 0x7A, 0x79, 0x1A, 0xAA, 0x67, 0x33, 0xCA, 0xA2, 0x74, 0x7A, 0xAC, 0xA0,
    0x69, 0x9E, 0x7A, 0xA4, 0xD9, 0x9A, 0x7A, 0x86, 0xC9, 0x00, 0x18, 0x73, 0x39, 0x99, 0xDA, 0x19,
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    0x93, 0x8A, 0x89,
};

// 查找单个汉字拼音首字母 ('A'~'Z'，未收录返回 0)
inline char getHanziPinyinInitial(uint16_t unicode) {
    if (unicode >= 0x4E00 && unicode <= 0x9FA5) {
        uint32_t idx = unicode - 0x4E00;
        uint8_t byte_val = pgm_read_byte(&s_hanzi_pinyin_nibbles[idx >> 1]);
        uint8_t val = (idx & 1) ? (byte_val & 0x0F) : (byte_val >> 4);
        if (val >= 1 && val <= 26) return 'A' + (val - 1);
    }
    return 0;
}

// 🌟 提取任意 UTF-8 字符（汉字拼音、韩文音节、日文五十音、英文字母、数字）的首字母排序键
inline char getSortInitialKey(const char* utf8_str) {
    if (!utf8_str || !*utf8_str) return '~';
    
    const unsigned char* p = (const unsigned char*)utf8_str;
    while (*p) {
        if (*p <= 0x20 || *p == '[' || *p == '(' || *p == '<' || *p == '\"' || *p == '\'' || *p == '.' || *p == '-' || *p == '_') {
            p++;
            continue;
        }
        if (p[0] == 0xE3 && p[1] == 0x80 && (p[2] == 0x8A || p[2] == 0x90)) { p += 3; continue; } // 《 【
        if (p[0] == 0xE2 && p[1] == 0x80 && (p[2] == 0x9C || p[2] == 0x98)) { p += 3; continue; } // “ ‘
        if (p[0] == 0xE2 && p[1] == 0x99 && p[2] == 0xAA) { p += 3; continue; } // ♪
        break;
    }
    if (!*p) return '~';

    // 1. ASCII 字符 (英文字母、数字)
    if (*p < 0x80) {
        char c = *p;
        if (c >= 'a' && c <= 'z') return c - 'a' + 'A';
        if (c >= 'A' && c <= 'Z') return c;
        if (c >= '0' && c <= '9') return c;
        return '~';
    }

    // 2. 解码第一个 UTF-8 Unicode 码点
    uint16_t u = 0;
    if ((p[0] & 0xE0) == 0xC0 && p[1]) {
        u = ((p[0] & 0x1F) << 6) | (p[1] & 0x3F);
    } else if ((p[0] & 0xF0) == 0xE0 && p[1] && p[2]) {
        u = ((p[0] & 0x0F) << 12) | ((p[1] & 0x3F) << 6) | (p[2] & 0x3F);
    }

    // 3. 中文汉字拼音首字母 (20,902 汉字全覆盖，严格映射为 A~Z)
    if (u >= 0x4E00 && u <= 0x9FA5) {
        char py = getHanziPinyinInitial(u);
        if (py >= 'A' && py <= 'Z') return py;
    }

    // 4. 日文、韩文与其它语言字符统一置于歌单最后 (返回 '~')
    return '~';
}

